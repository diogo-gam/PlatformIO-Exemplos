/*
 *  All-in-one setPWM
 *  This example shows how to configure a PWM with HardwareTimer in one single function call.
 *  No interruption callback used: PWM is generated by hardware.
 *  Once configured, there is no CPU load.
 *
 *  Note: Please verify that 'pin' used for PWM has HardwareTimer capability for your board
 *  This is specially true for F1 serie (BluePill, ...)
 *
 *  HardwareTimer:
 *    https://github.com/stm32duino/STM32Examples/blob/master/examples/Peripherals/HardwareTimer/All-in-one_setPWM/All-in-one_setPWM.ino
 *    https://github.com/stm32duino/Arduino_Core_STM32/blob/master/cores/arduino/HardwareTimer.cpp
 *    https://github.com/stm32duino/wiki/wiki/HardwareTimer-library
 *    https://github.com/stm32duino/STM32Examples/tree/master/examples/Peripherals/HardwareTimer
 * 
 *  DMA:
 *    https://github.com/rogerclarkmelbourne/Arduino_STM32/blob/master/STM32F1/libraries/STM32ADC/examples/MultiChannelSingleConversion/MultiChannelSingleConversion.ino
 */
#include <Arduino.h>

int pins[4] = { PA0, PA1, PA2, PA3};
uint32_t channels[4];

#define OUTPUT_PORT Serial

#define SCH1 PA4
#define SCH2 PA5
#define N_SOFT_CHANNELS 2

int soft_channels[N_SOFT_CHANNELS] = {SCH1, SCH2};
int chState = 0;

unsigned long previousMicros = 0;
const long interval = 1;

void setup()
{
  // no need to configure pin, it will be done by HardwareTimer configuration
  // pinMode(pin, OUTPUT);

  // Automatically retrieve TIM instance and channel associated to pin
  // This is used to be compatible with all STM32 series automatically.
  TIM_TypeDef *Instance = (TIM_TypeDef *)pinmap_peripheral(digitalPinToPinName(pins[0]), PinMap_PWM); /*TIMER2 (4 CANAIS)*/
  for (uint8_t i = 0; i < 4; i++)
  {
    channels[i] = STM_PIN_CHANNEL(pinmap_function(digitalPinToPinName(pins[i]), PinMap_PWM));
  }
    
  // Instantiate HardwareTimer object. Thanks to 'new' instantiation, HardwareTimer is not destructed when setup() function is finished.
  HardwareTimer *MyTim = new HardwareTimer(Instance);

  // Configure and start PWM
  MyTim->setPWM(channels[0], pins[0], 20000, 10);
  MyTim->setPWM(channels[1], pins[1], 20000, 20);
  MyTim->setPWM(channels[2], pins[2], 20000, 30);
  MyTim->setPWM(channels[3], pins[3], 20000, 40);


  for (int i = 0; i < N_SOFT_CHANNELS; i++)
  {
    pinMode(soft_channels[i], OUTPUT);
  }

  OUTPUT_PORT.begin(115200);
  OUTPUT_PORT.println(F("\r\n\nSistema Iniciado:"));
}


void loop()
{
  unsigned long currentMicros = micros();
  if(currentMicros - previousMicros >= interval) {
    previousMicros = currentMicros;
    chState = !chState;
    for (int i = 0; i < N_SOFT_CHANNELS; i++)
    {
      digitalWrite(soft_channels[i], chState);
    }
  }
}