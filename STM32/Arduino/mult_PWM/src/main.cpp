/*
 *  All-in-one setPWM
 *  This example shows how to configure a PWM with HardwareTimer in one single function call.
 *  PWM is generated on `LED_BUILTIN` if available.
 *  No interruption callback used: PWM is generated by hardware.
 *  Once configured, there is no CPU load.
 *
 *  Note: Please verify that 'pin' used for PWM has HardwareTimer capability for your board
 *  This is specially true for F1 serie (BluePill, ...)
 *
 *  HardwareTimer:
 *    https://github.com/stm32duino/STM32Examples/blob/master/examples/Peripherals/HardwareTimer/All-in-one_setPWM/All-in-one_setPWM.ino
 *    https://github.com/stm32duino/Arduino_Core_STM32/blob/master/cores/arduino/HardwareTimer.cpp
 *    https://github.com/stm32duino/wiki/wiki/HardwareTimer-library
 *    https://github.com/stm32duino/STM32Examples/tree/master/examples/Peripherals/HardwareTimer
 * 
 *  DMA:
 *    https://github.com/rogerclarkmelbourne/Arduino_STM32/blob/master/STM32F1/libraries/STM32ADC/examples/MultiChannelSingleConversion/MultiChannelSingleConversion.ino
 */
#include <Arduino.h>

#define pin PA0

#define OUTPUT_PORT Serial

#define CH1 PA4
#define CH2 PA5
#define CH3 PA6
#define N_CHANNELS 3

int channels[N_CHANNELS] = {CH1, CH2, CH3};
// int chState[N_CHANNELS] = 0;
int chState = 0;

unsigned long previousMicros = 0;
const long interval = 25; // (1/25)uS


void setup()
{
  // no need to configure pin, it will be done by HardwareTimer configuration
  // pinMode(pin, OUTPUT);

  // Automatically retrieve TIM instance and channel associated to pin
  // This is used to be compatible with all STM32 series automatically.
  TIM_TypeDef *Instance = (TIM_TypeDef *)pinmap_peripheral(digitalPinToPinName(pin), PinMap_PWM);
  uint32_t channel = STM_PIN_CHANNEL(pinmap_function(digitalPinToPinName(pin), PinMap_PWM));


  // Instantiate HardwareTimer object. Thanks to 'new' instantiation, HardwareTimer is not destructed when setup() function is finished.
  HardwareTimer *MyTim = new HardwareTimer(Instance);

  // Configure and start PWM
  // MyTim->setPWM(channel, pin, 5, 10, NULL, NULL); // No callback required, we can simplify the function call
  MyTim->setPWM(channel, pin, 20000, 10); // 20khz, 10% dutycycle

  for (int i = 0; i < N_CHANNELS; i++)
  {
    pinMode(channels[i], OUTPUT);
  }
  
  OUTPUT_PORT.begin(115200);
  OUTPUT_PORT.println(F("\r\n\nSistema Iniciado:"));
}


void loop()
{
  unsigned long currentMicros = micros();
  if(currentMicros - previousMicros >= interval) {
    previousMicros = currentMicros;
    chState = !chState;
    for (int i = 0; i < N_CHANNELS; i++)
    {
      digitalWrite(channels[i], chState);
    }
  }
}